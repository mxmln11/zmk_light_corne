## config/west.yml
```yaml
manifest:
  remotes:
    - name: zmkfirmware
      url-base: https://github.com/zmkfirmware
    - name: m165437 #new entry
      url-base: https://github.com/M165437 #new entry
    # - name: sadekbaroudi
    #  url-base: https://github.com/sadekbaroudi
    - name: aym1607
      url-base: https://github.com/aym1607
      
  projects:
    - name: zmk
      remote: zmkfirmware
      revision: v0.3
      import: app/west.yml
    - name: nice-view-gem #new entry
      remote: m165437 #new entry
      revision: v0.3.0 #main #new entry
    - name: zmk-driver-azoteq-iqs5xx
      remote: aym1607
      revision: main

  self:
    path: config
```
